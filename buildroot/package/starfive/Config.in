## buildroot/package/starfive/Config.in
```kconfig
# starfive packages
source "package/starfive/wave511/Config.in"
source "package/starfive/wave521/Config.in"
source "package/starfive/wave420l/Config.in"
source "package/starfive/codaj12/Config.in"
source "package/starfive/sf-omx-il/Config.in"
source "package/starfive/sf-omx-il-test/Config.in"
source "package/starfive/v4l2_test/Config.in"
source "package/starfive/libcamera-apps/Config.in"
source "package/starfive/sf-gst-omx/Config.in"
source "package/starfive/ispsdk/Config.in"
source "package/starfive/mailbox-test/Config.in"
source "package/starfive/e24-test/Config.in"
source "package/starfive/img-gpu-powervr/Config.in"
source "package/starfive/drm_test/Config.in"
source "package/starfive/pm/Config.in"
source "package/starfive/usb_wifi/Config.in"
```

## buildroot/package/starfive/ap6256_bluetooth/Config.in
```kconfig
config BR2_PACKAGE_AP6256_BLUETOOTH
    bool "AP6256 Bluetooth"
    help
      Firmware files for AP6256 Wireless bluetooth support.
```

## buildroot/package/starfive/codaj12/Config.in
```kconfig
comment "codaj12 package"

config BR2_PACKAGE_CODAJ12
	bool "codaj12"
	help
	  codaj12 package
```

## buildroot/package/starfive/drm_test/Config.in
```kconfig
comment "drm test package"

config BR2_PACKAGE_DRM_TEST
	bool "drm_test"
	depends on BR2_PACKAGE_LIBDRM
	help
	  Utility for testing drm working on variable modes. This tool based on
	  https://github.com/dvdhrm/docs.git and 
	  https://github.com/hexiaolong2008/sample-code.git,
	  but provides additional features
```

## buildroot/package/starfive/ispsdk/Config.in
```kconfig
comment "starfive ispsdk package"

config BR2_PACKAGE_ISPSDK
	bool "ispsdk"
	help
	  starfive ispsdk package
```

## buildroot/package/starfive/libcamera-apps/Config.in
```kconfig
config BR2_PACKAGE_LIBCAMERA_APPS
	bool "libcamera-apps"
	depends on BR2_PACKAGE_LIBCAMERA
	select BR2_PACKAGE_GNUTLS
	select BR2_PACKAGE_BOOST
	select BR2_PACKAGE_BOOST_PROGRAM_OPTIONS
	select BR2_PACKAGE_BOOST_SYSTEM
	select BR2_PACKAGE_TIFF
	select BR2_PACKAGE_LIBEXIF
	select BR2_PACKAGE_LIBYUV
	select BR2_PACKAGE_LIBPNG
	help
	  libcamera-apps provides a software stack to support
	  complex devices that need heavy hardware image
	  processing operations.

comment "libcamera-apps needs a toolchain w/ C++, threads, wchar, dynamic library, gcc >= 7"
	depends on !BR2_INSTALL_LIBSTDCPP || !BR2_TOOLCHAIN_HAS_THREADS || \
		!BR2_TOOLCHAIN_GCC_AT_LEAST_7 || BR2_STATIC_LIBS || !BR2_USE_WCHAR
```

## buildroot/package/starfive/mailbox-test/Config.in
```kconfig
config BR2_PACKAGE_MAILBOX_TEST
	bool "mailbox-test"
	help
	  mailbox-test package
```

## buildroot/package/starfive/pm/Config.in
```kconfig
comment "pm package"

config BR2_PACKAGE_PM
	bool "pm"
	help
	  Utility for pm initialization & configuration.
```

## buildroot/package/starfive/sdio_wifi/Config.in
```kconfig
config BR2_PACKAGE_SDIO_WIFI
        bool "sdio wifi ap6256"
        help
          firmware and configuration file for sdio wifi ap6256
```

## buildroot/package/starfive/sf-gst-omx/Config.in
```kconfig
config BR2_PACKAGE_SF_GST_OMX
	bool "sf-gst-omx"
	depends on BR2_PACKAGE_SF_OMX_IL
	select BR2_PACKAGE_GST1_PLUGINS_BASE
	help
	  GStreamer plug-in to use OpenMAX API.

	  https://cgit.freedesktop.org/gstreamer/gst-omx

comment "gst-omx requires a OpenMAX implementation"
	depends on !BR2_PACKAGE_SF_OMX_IL
```

## buildroot/package/starfive/sf-omx-il-test/Config.in
```kconfig
config BR2_PACKAGE_SF_OMX_IL_TEST
	bool "sf-omx-il-test"
	depends on BR2_PACKAGE_SF_OMX_IL && BR2_PACKAGE_FFMPEG
	help
	  sf-omx-il-test package

comment "sf-omx-il-test package requires a OpenMAX implementation"
	depends on !BR2_PACKAGE_SF_OMX_IL || !BR2_PACKAGE_FFMPEG
```

## buildroot/package/starfive/sf-omx-il/Config.in
```kconfig
comment "sf openmax il package"

config BR2_PACKAGE_SF_OMX_IL
	bool "sf-omx-il"
	depends on BR2_PACKAGE_WAVE511 && (BR2_PACKAGE_WAVE420L || BR2_PACKAGE_WAVE521) && BR2_PACKAGE_CODAJ12
	help
	  sf-omx-il package
```

## buildroot/package/starfive/stfisp_setfile/Config.in.host
```kconfig
config BR2_PACKAGE_HOST_STFISP_SETFILE
	bool "host generate isp fw"
	help
	  stfisp_setfile is a tool to generate ISP fw image
```

## buildroot/package/starfive/usb_wifi/Config.in
```kconfig
config BR2_PACKAGE_USB_WIFI
	bool "usb wifi ecr6600u/aic8800"
	help
	  firmware for usb wifi ecr6600u/aic8800
```

## buildroot/package/starfive/v4l2_dec_test/Config.in
```kconfig
config BR2_PACKAGE_V4L2_DEC_TEST
	bool "v4l2 decode test"
	depends on BR2_PACKAGE_SF_OMX_IL && BR2_PACKAGE_FFMPEG
	depends on BR2_TOOLCHAIN_HAS_THREADS # libv4l
	depends on BR2_USE_MMU # libv4l
	depends on !BR2_STATIC_LIBS # libv4l
	depends on BR2_INSTALL_LIBSTDCPP # libv4l
	depends on BR2_TOOLCHAIN_HEADERS_AT_LEAST_3_0 # libv4l
	select BR2_PACKAGE_LIBV4L
	help
	  v4l2 decoder package

comment "v4l2 decoder package requires ffmpeg implementation"
	depends on !BR2_PACKAGE_FFMPEG
```

## buildroot/package/starfive/wave420l/Config.in
```kconfig
comment "wave420l package"

config BR2_PACKAGE_WAVE420L
	bool "wave420l"
	help
	  wave420l package
```

## buildroot/package/starfive/wave511/Config.in
```kconfig
comment "wave511 package"

config BR2_PACKAGE_WAVE511
	bool "wave511"
	help
	  wave511 package
```

## buildroot/package/starfive/wave521/Config.in
```kconfig
comment "wave521 package"

config BR2_PACKAGE_WAVE521
	bool "wave521"
	help
	  wave521 package
```
